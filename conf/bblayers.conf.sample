## conf/bblayers.conf.sample
```bitbake
# POKY_BBLAYERS_CONF_VERSION is increased each time build/conf/bblayers.conf
# changes incompatibly
POKY_BBLAYERS_CONF_VERSION = "2"

BBPATH = "${TOPDIR}"
BBFILES ?= ""

BBLAYERS ?= " \
    ${HOME}/poky-walnascar/meta \
    ${HOME}/poky-walnascar/meta-poky \
    ${HOME}/poky-walnascar/meta-openembedded/meta-oe \
    ${HOME}/poky-walnascar/meta-openembedded/meta-multimedia \
    ${HOME}/poky-walnascar/meta-openembedded/meta-networking \
    ${HOME}/poky-walnascar/meta-openembedded/meta-python \
    ${HOME}/poky-walnascar/meta-raspberrypi \
    ${HOME}/poky-walnascar/meta-security \
    ${HOME}/rpi/meta-rpi \
"
```

## conf/local.conf.sample
```bitbake
# Local configuration for meta-rpi images
# Yocto Project 5.2 Poky distribution [walnascar] branch

LICENSE_FLAGS_ACCEPTED = "commercial synaptics-killswitch"

DISTRO_FEATURES = "ext2 security systemd usbhost wifi ${DISTRO_FEATURES_LIBC}"

DISTRO_FEATURES_BACKFILL_CONSIDERED += "sysvinit"

DISTRO_FEATURES:remove = "ptest"

INIT_MANAGER = "systemd"

MACHINE_FEATURES:remove = "apm vfat"

IMAGE_FSTYPES = "tar.xz"

MACHINE = "raspberrypi3"
#MACHINE = "raspberrypi0-wifi"

KERNEL_IMAGETYPE = "zImage"

DISABLE_VC4GRAPHICS = "1"
DISABLE_OVERSCAN = "1"

PREFERRED_VERSION_linux-raspberrypi = "6.12.%"

#DL_DIR = "/src/walnascar"
#SSTATE_DIR = "/oe1/rpi/sstate-cache"
#TMPDIR = "/oe1/rpi/tmp"

DISTRO = "poky"
PACKAGE_CLASSES = "package_ipk"

SDKMACHINE = "x86_64"

EXTRA_IMAGE_FEATURES = "empty-root-password allow-empty-password allow-root-login"

PATCHRESOLVE = "noop"
RM_OLD_IMAGE = "1"
INHERIT += "rm_work"
CONF_VERSION = "2"
```
